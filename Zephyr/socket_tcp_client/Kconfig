## Zephyr/socket_tcp_client/Kconfig
```kconfig
if WIFI

config WIFI_SSID
	string "WIFI SSID - Network name"
	default "GUZMAN"

config WIFI_PSK
	string "WIFI PSK - Network password key"
	default "1234567890"

endif # WIFI

config IP_SERVER
  string "IP_SERVER - IP donde se encuentra el servicio TCP"
  default "127.0.1.1"

config PORT_SERVER
  int "PORT_SERVER - Puerto por el que se presta el servicio TCP"
  default 3000

source "Kconfig.zephyr"
```
