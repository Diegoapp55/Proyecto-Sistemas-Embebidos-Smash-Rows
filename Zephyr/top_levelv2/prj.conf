## CMakeLists.txt
```
# SPDX-License-Identifier: Apache-2.0

cmake_minimum_required(VERSION 3.20.0)
find_package(Zephyr REQUIRED HINTS $ENV{ZEPHYR_BASE})
project(blinky)

# FILE(GLOB app_sources src/*.c)
target_sources(app PRIVATE ${app_sources})
target_sources_ifdef(CONFIG_WIFI app PRIVATE src/wifi.c)
target_sources(app PRIVATE src/dhcp.c)
target_sources(app PRIVATE src/tcp_client.c)
target_sources(app PRIVATE src/main.c)
target_sources(app PRIVATE src/motores.c)
```

## sample.yaml
```
sample:
  name: Blinky Sample
tests:
  sample.basic.blinky:
    tags: LED gpio
    filter: dt_enabled_alias_with_parent_compat("led0", "gpio-leds")
    depends_on: gpio
    harness: led
    integration_platforms:
      - frdm_k64f
common:
  harness: net
  tags: net wifi
sample:
  description: Test wifi driver and APIs functionality
  name: WiFi sample app
tests:
  sample.net.wifi:
    platform_allow: cc3220sf_launchxl disco_l475_iot1 reel_board
  sample.net.wifi.mikroe_wifi_bt_click:
    extra_args: SHIELD=mikroe_wifi_bt_click_mikrobus
    platform_allow: lpcxpresso55s69_cpu0
  sample.net.wifi.esp_8266:
    extra_args: SHIELD=esp_8266
    platform_allow: sam4e_xpro
  sample.net.wifi.esp_8266_arduino:
    extra_args: SHIELD=esp_8266_arduino
    platform_allow: frdm_k64f disco_l475_iot1
  sample.net.wifi.inventek_eswifi_arduino_uart:
    extra_args: SHIELD=inventek_eswifi_arduino_uart
    platform_allow: frdm_k64f nucleo_f767zi
  sample.net.wifi.inventek_eswifi_arduino_spi:
    extra_args: SHIELD=inventek_eswifi_arduino_spi
    platform_allow: frdm_k64f nucleo_f767zi
  esp32:
    extra_args: OVERLAY_CONFIG="overlay-wifi.conf"
    platform_allow: esp32
```

## prj.conf
```kconfig
CONFIG_GPIO=y

CONFIG_EARLY_CONSOLE=y
# CONFIG_EARLY_CONSOLE=n

CONFIG_NETWORKING=y
# CONFIG_TEST_RANDOM_GENERATOR=y
CONFIG_TEST_RANDOM_GENERATOR=n

CONFIG_NET_TX_STACK_SIZE=2048
CONFIG_NET_RX_STACK_SIZE=2048

CONFIG_NET_PKT_RX_COUNT=10
CONFIG_NET_PKT_TX_COUNT=10
CONFIG_NET_BUF_RX_COUNT=20
CONFIG_NET_BUF_TX_COUNT=20
CONFIG_NET_MAX_CONTEXTS=10
CONFIG_NET_DHCPV4=y

CONFIG_NET_IPV4=y
CONFIG_NET_IPV6=n

CONFIG_NET_TCP=y

#############
# LOG CONFIG
#############
CONFIG_LOG=y
CONFIG_NET_LOG=y # usar
CONFIG_INIT_STACKS=y

# CONFIG_NET_SHELL=n
CONFIG_NET_SHELL=y

CONFIG_NET_STATISTICS=y
CONFIG_NET_STATISTICS_PERIODIC_OUTPUT=n

################
# SOCKET CONFIG
################

CONFIG_NET_SOCKETS=y

##############
# WIFI CONFIG
##############

CONFIG_WIFI=y
CONFIG_WIFI_LOG_LEVEL_ERR=n
CONFIG_NET_L2_WIFI_SHELL=y

CONFIG_HEAP_MEM_POOL_SIZE=98304
CONFIG_NET_L2_ETHERNET=y

##############
# WIFI and TCP CONFIG
##############
CONFIG_WIFI_SSID="Honor 8X"
CONFIG_WIFI_PSK="tolimacampeon"
CONFIG_IP_SERVER="192.168.43.199"
CONFIG_PORT_SERVER=3000 
# CONFIG_ESP32_WIFI_STA_AUTO_DHCPV4=y
```

## src/main.c
```c
/*
 * Copyright (c) 2016 Intel Corporation
 *
 * SPDX-License-Identifier: Apache-2.0
 */


 #include <zephyr/kernel.h>
 #include <zephyr/drivers/gpio.h>
 #include <esp_log.h>

#include <stdio.h>
#include <zephyr/logging/log.h>
LOG_MODULE_REGISTER(main, CONFIG_LOG_DEFAULT_LEVEL);
/* LOG_MODULE_REGISTER(main, CONFIG_LOG_DEFAULT_LEVEL); */
/* LOG_MODULE_DECLARE(main, CONFIG_LOG_DEFAULT_LEVEL); */

#include "wifi.h"
#include "dhcp.h"
#include "tcp_client.h"



/* 1000 msec = 1 sec */
#define SLEEP_TIME   3

/* Define all coils for the motors */
/*Nodo del blink para depurar*/
#define LED0_NODE DT_ALIAS(led0)
/*Nodos del motor 1*/
#define COIL1_NODE DT_ALIAS(coil1alias)
#define COIL2_NODE DT_ALIAS(coil2alias)
#define COIL3_NODE DT_ALIAS(coil3alias)
#define COIL4_NODE DT_ALIAS(coil4alias)

/*Nodos del motor 2*/
#define COIL5_NODE DT_ALIAS(coil5alias)
#define COIL6_NODE DT_ALIAS(coil6alias)
#define COIL7_NODE DT_ALIAS(coil7alias)
#define COIL8_NODE DT_ALIAS(coil8alias)

/*Nodo del RFID*/
#define RFID_NODE DT_ALIAS(rfid0alias)

#define SUCCESSFUL 0
#define OK 0
#define ERROR 1

/*Llamado a los pines reales del led*/
static const struct gpio_dt_spec led = GPIO_DT_SPEC_GET(LED0_NODE, gpios);

/*Llamado a los pines reales motor 1*/
static const struct gpio_dt_spec coil1 = GPIO_DT_SPEC_GET(COIL1_NODE, gpios);
static const struct gpio_dt_spec coil2 = GPIO_DT_SPEC_GET(COIL2_NODE, gpios);
static const struct gpio_dt_spec coil3 = GPIO_DT_SPEC_GET(COIL3_NODE, gpios);
static const struct gpio_dt_spec coil4 = GPIO_DT_SPEC_GET(COIL4_NODE, gpios);

/*Llamado a los pines reales motor 2*/
static const struct gpio_dt_spec coil5 = GPIO_DT_SPEC_GET(COIL5_NODE, gpios);
static const struct gpio_dt_spec coil6 = GPIO_DT_SPEC_GET(COIL6_NODE, gpios);
static const struct gpio_dt_spec coil7 = GPIO_DT_SPEC_GET(COIL7_NODE, gpios);
static const struct gpio_dt_spec coil8 = GPIO_DT_SPEC_GET(COIL8_NODE, gpios);

/*Llamado al pin real del RFID*/
static const struct gpio_dt_spec rfid0 = GPIO_DT_SPEC_GET(RFID_NODE, gpios);

int leerTabla(int paso[], int posicion){
	int lectura = paso[posicion];
  printf("prueba2\n");
	return lectura;
}

int led_debug_init(void)
{
	if (!device_is_ready(led.port))
		return ERROR;
	if(gpio_pin_configure_dt(&led, GPIO_OUTPUT_ACTIVE) < 0)
    return ERROR;
  return SUCCESSFUL;
}

/* Función que configura los pines como salidas (o entradas) y con valor inicial igual a 0 */
void pins_config_init(void)
{
  int ret;
	ret = gpio_pin_configure_dt(&coil1, GPIO_OUTPUT_LOW);
  printk("%d ", ret);
	ret = gpio_pin_configure_dt(&coil2, GPIO_OUTPUT_LOW);
  printk("%d ", ret);
	ret = gpio_pin_configure_dt(&coil3, GPIO_OUTPUT_LOW);
  printk("%d ", ret);
	ret = gpio_pin_configure_dt(&coil4, GPIO_OUTPUT_LOW);
  printk("%d ", ret);
	ret = gpio_pin_configure_dt(&coil5, GPIO_OUTPUT_LOW);
  printk("%d ", ret);
	ret = gpio_pin_configure_dt(&coil6, GPIO_OUTPUT_LOW);
  printk("%d ", ret);
	ret = gpio_pin_configure_dt(&coil7, GPIO_OUTPUT_LOW);
  printk("%d ", ret);
	ret = gpio_pin_configure_dt(&coil8, GPIO_OUTPUT_LOW);
  printk("%d ", ret);

	/*pin del RFID*/
	ret = gpio_pin_configure_dt(&rfid0, GPIO_INPUT);
	printk("%d ", ret);																						/*Si hay un error puede ser acá, no estoy seguro de esto*/

}



/* A partir de aquí modificamos el void*/


void main(void)
{
	/*Lo del blink para depurar*/
	/* if (!device_is_ready(led.port)) { */
	/* 	return; */
	/* } */

	/* ret = gpio_pin_configure_dt(&led, GPIO_OUTPUT_ACTIVE); */
	/* if (ret < 0) { */
	/* 	return; */
	/* } */


  /* Iniciar led de debug */
  if(led_debug_init() == ERROR)
    return;

  /* Iniciar steppers */
  pins_config_init();

	printf("aviso1\n");
	LOG_INF("WiFi demo");

	wifi_connect();

	dhcpv4_startup();

	LOG_INF("Should have DHCPv4 lease at this point.");

	LOG_INF("Start tcp_client_start");

	k_msleep(1000);

	tcp_client_start();
  motores_star();
printf("prueba1\n");
  //
	// int ret = 0;
	// int llego = 0;
	// int arduino = 0;
	// int vel_motor=1000;
	// int count_step = 0;
	// int round_step = 4076;
  //
  //
	// const int numberSteps = 3200;
	// const int tableSteps[4] = {0x8, 0x4, 0x2, 0x1};
  // printf("prueba2\n");
	// //Si no se mueve lo suficiente, probar antes con while(1)
	// while(1){
	// 	arduino = gpio_pin_get_dt(&rfid0);
	// 	printk("Lectura=%d, ",arduino);
  //   printf("prueba3");
		// if (gpio_pin_get_dt(&rfid0)==1){
		// llego = 1;
    // printf("prueba1\n", );

//
// 		while (count_step<numberSteps) { //En vez de 1 poner señal de control que se active con la orden de dispensar y se apague hasta que lo haga
// 			// ret = gpio_pin_set_dt(&coil1, 1/0)
// 			// Cambio el valor de los pines coilX
//       llego=0;
//       printf("prueba1\n");
// // 				for (int i = 0; i < 4; i++) {
// // 					switch (tableSteps[i]) {
// // 						case 0x8:
// // 							gpio_pin_set_dt(&coil1, 0);
// // 							gpio_pin_set_dt(&coil2, 1);
// // 							gpio_pin_set_dt(&coil3, 1);
// // 							gpio_pin_set_dt(&coil4, 1);
// // 							break;
// // 						case 0x4:
// // 							gpio_pin_set_dt(&coil1, 1);
// // 							gpio_pin_set_dt(&coil2, 0);
// // 							gpio_pin_set_dt(&coil3, 1);
// // 							gpio_pin_set_dt(&coil4, 1);
// // 							break;
// // 						case 0x2:
// // 							gpio_pin_set_dt(&coil1, 1);
// // 							gpio_pin_set_dt(&coil2, 1);
// // 							gpio_pin_set_dt(&coil3, 0);
// // 							gpio_pin_set_dt(&coil4, 1);
// // 							break;
// // 						case 0x1:
// // 							gpio_pin_set_dt(&coil1, 1);
// // 							gpio_pin_set_dt(&coil2, 1);
// // 							gpio_pin_set_dt(&coil3, 1);
// // 							gpio_pin_set_dt(&coil4, 0);
// // 							break;
// // 					}
// 					k_msleep(10*SLEEP_TIME);
// 					count_step++; //Revisar si esto está bien o es mejor ponerlo fuera del for para que cuente vueltasy no cada paso
// 				}
//
//
// 			// ret = gpio_pin_toggle_dt(&led);
// 			// if (ret < 0) {
// 			// 	return;
// 			// }
// 		}
//
// 	k_msleep(5*SLEEP_TIME);
// 	count_step=0;
//
// 		while (count_step<numberSteps) { //En vez de 1 poner señal de control que se active con la orden de dispensar y se apague hasta que lo haga
// 			// ret = gpio_pin_set_dt(&coil1, 1/0)
// 			// Cambio el valor de los pines coilX
// 				for (int i = 0; i < 4; i++) {
// 					switch (tableSteps[i]) {
// 						case 0x8:
// 							gpio_pin_set_dt(&coil5, 0);
// 							gpio_pin_set_dt(&coil6, 1);
// 							gpio_pin_set_dt(&coil7, 1);
// 							gpio_pin_set_dt(&coil8, 1);
// 							break;
// 						case 0x4:
// 							gpio_pin_set_dt(&coil5, 1);
// 							gpio_pin_set_dt(&coil6, 0);
// 							gpio_pin_set_dt(&coil7, 1);
// 							gpio_pin_set_dt(&coil8, 1);
// 							break;
// 						case 0x2:
// 							gpio_pin_set_dt(&coil5, 1);
// 							gpio_pin_set_dt(&coil6, 1);
// 							gpio_pin_set_dt(&coil7, 0);
// 							gpio_pin_set_dt(&coil8, 1);
// 							break;
// 						case 0x1:
// 							gpio_pin_set_dt(&coil5, 1);
// 							gpio_pin_set_dt(&coil6, 1);
// 							gpio_pin_set_dt(&coil7, 1);
// 							gpio_pin_set_dt(&coil8, 0);
// 							break;
// 					}
// 					k_msleep(SLEEP_TIME);
// 					count_step++; //Revisar si esto está bien o es mejor ponerlo fuera del for para que cuente vueltasy no cada paso
// 				}
//
//
// 			//ret = gpio_pin_toggle_dt(&led);
// 			//if (ret < 0) {
// 			//	return;
// 			//}
// 		}
//
// 		k_msleep(5*SLEEP_TIME);
// 		count_step=0;
//
//	}
// 	else{
// 		llego = 0;
//
// 		// return;							/* Esto también ni idea, lo puse porque quedaba lendo*/
// 	}
//
//
// 	//printk("Llego=%d\n", llego);
// }
}
```

## src/motores.c
```c
/*
 * Copyright (c) 2016 Intel Corporation
 *
 * SPDX-License-Identifier: Apache-2.0
 */

#include <zephyr/kernel.h>
#include <zephyr/drivers/gpio.h>
#include <esp_log.h>

/* 1000 msec = 1 sec */
#define SLEEP_TIME   3

/* Define all coils for the motors */
/*Nodo del blink para depurar*/
#define LED0_NODE DT_ALIAS(led0)
/*Nodos del motor 1*/
#define COIL1_NODE DT_ALIAS(coil1alias)
#define COIL2_NODE DT_ALIAS(coil2alias)
#define COIL3_NODE DT_ALIAS(coil3alias)
#define COIL4_NODE DT_ALIAS(coil4alias)

/*Nodos del motor 2*/
#define COIL5_NODE DT_ALIAS(coil5alias)
#define COIL6_NODE DT_ALIAS(coil6alias)
#define COIL7_NODE DT_ALIAS(coil7alias)
#define COIL8_NODE DT_ALIAS(coil8alias)

/*Nodo del RFID*/
#define RFID_NODE DT_ALIAS(rfid0alias)

#define SUCCESSFUL 0
#define OK 0
#define ERROR 1

/*Llamado a los pines reales del led*/
static const struct gpio_dt_spec led = GPIO_DT_SPEC_GET(LED0_NODE, gpios);

/*Llamado a los pines reales motor 1*/
static const struct gpio_dt_spec coil1 = GPIO_DT_SPEC_GET(COIL1_NODE, gpios);
static const struct gpio_dt_spec coil2 = GPIO_DT_SPEC_GET(COIL2_NODE, gpios);
static const struct gpio_dt_spec coil3 = GPIO_DT_SPEC_GET(COIL3_NODE, gpios);
static const struct gpio_dt_spec coil4 = GPIO_DT_SPEC_GET(COIL4_NODE, gpios);

/*Llamado a los pines reales motor 2*/
static const struct gpio_dt_spec coil5 = GPIO_DT_SPEC_GET(COIL5_NODE, gpios);
static const struct gpio_dt_spec coil6 = GPIO_DT_SPEC_GET(COIL6_NODE, gpios);
static const struct gpio_dt_spec coil7 = GPIO_DT_SPEC_GET(COIL7_NODE, gpios);
static const struct gpio_dt_spec coil8 = GPIO_DT_SPEC_GET(COIL8_NODE, gpios);

/*Llamado al pin real del RFID*/
static const struct gpio_dt_spec rfid0 = GPIO_DT_SPEC_GET(RFID_NODE, gpios);

int leerTabla(int paso[], int posicion){
	int lectura = paso[posicion];
	return lectura;
}

int led_debug_init(void)
{
	if (!device_is_ready(led.port))
		return ERROR;
	if(gpio_pin_configure_dt(&led, GPIO_OUTPUT_ACTIVE) < 0)
    return ERROR;
  return SUCCESSFUL;
}

/* Función que configura los pines como salidas (o entradas) y con valor inicial igual a 0 */
void pins_config_init(void)
{
  int ret;
	ret = gpio_pin_configure_dt(&coil1, GPIO_OUTPUT_LOW);
  printk("%d ", ret);
	ret = gpio_pin_configure_dt(&coil2, GPIO_OUTPUT_LOW);
  printk("%d ", ret);
	ret = gpio_pin_configure_dt(&coil3, GPIO_OUTPUT_LOW);
  printk("%d ", ret);
	ret = gpio_pin_configure_dt(&coil4, GPIO_OUTPUT_LOW);
  printk("%d ", ret);
	ret = gpio_pin_configure_dt(&coil5, GPIO_OUTPUT_LOW);
  printk("%d ", ret);
	ret = gpio_pin_configure_dt(&coil6, GPIO_OUTPUT_LOW);
  printk("%d ", ret);
	ret = gpio_pin_configure_dt(&coil7, GPIO_OUTPUT_LOW);
  printk("%d ", ret);
	ret = gpio_pin_configure_dt(&coil8, GPIO_OUTPUT_LOW);
  printk("%d ", ret);

	/*pin del RFID*/
	ret = gpio_pin_configure_dt(&rfid0, GPIO_INPUT);
	printk("%d ", ret);																						/*Si hay un error puede ser acá, no estoy seguro de esto*/

}

int motores_star(void)
{
	int ret = 0;
	int llego = 0;
	int arduino = 0;
	int vel_motor=1000;
	int count_step = 0;
	int round_step = 4076;


	const int numberSteps = 3200;
	const int tableSteps[4] = {0x8, 0x4, 0x2, 0x1};

	/*Lo del blink para depurar*/
	/* if (!device_is_ready(led.port)) { */
	/* 	return; */
	/* } */

	/* ret = gpio_pin_configure_dt(&led, GPIO_OUTPUT_ACTIVE); */
	/* if (ret < 0) { */
	/* 	return; */
	/* } */


  /* Iniciar led de debug */
  if(led_debug_init() == ERROR)
    return;

  /* Iniciar steppers */
  pins_config_init();

	//Si no se mueve lo suficiente, probar antes con while(1)
	while(1){
		arduino = gpio_pin_get_dt(&rfid0);
		printk("Lectura=%d, ",arduino);
		if (gpio_pin_get_dt(&rfid0)==1){
		llego = 1;


		while (count_step<numberSteps) { //En vez de 1 poner señal de control que se active con la orden de dispensar y se apague hasta que lo haga
			// ret = gpio_pin_set_dt(&coil1, 1/0)
			// Cambio el valor de los pines coilX
				for (int i = 0; i < 4; i++) {
					switch (tableSteps[i]) {
						case 0x8:
							gpio_pin_set_dt(&coil1, 0);
							gpio_pin_set_dt(&coil2, 1);
							gpio_pin_set_dt(&coil3, 1);
							gpio_pin_set_dt(&coil4, 1);
							break;
						case 0x4:
							gpio_pin_set_dt(&coil1, 1);
							gpio_pin_set_dt(&coil2, 0);
							gpio_pin_set_dt(&coil3, 1);
							gpio_pin_set_dt(&coil4, 1);
							break;
						case 0x2:
							gpio_pin_set_dt(&coil1, 1);
							gpio_pin_set_dt(&coil2, 1);
							gpio_pin_set_dt(&coil3, 0);
							gpio_pin_set_dt(&coil4, 1);
							break;
						case 0x1:
							gpio_pin_set_dt(&coil1, 1);
							gpio_pin_set_dt(&coil2, 1);
							gpio_pin_set_dt(&coil3, 1);
							gpio_pin_set_dt(&coil4, 0);
							break;
					}
					k_msleep(SLEEP_TIME);
					count_step++; //Revisar si esto está bien o es mejor ponerlo fuera del for para que cuente vueltasy no cada paso
				}


			// ret = gpio_pin_toggle_dt(&led);
			// if (ret < 0) {
			// 	return;
			// }
		}

	k_msleep(5*SLEEP_TIME);
	count_step=0;

		while (count_step<numberSteps) { //En vez de 1 poner señal de control que se active con la orden de dispensar y se apague hasta que lo haga
			// ret = gpio_pin_set_dt(&coil1, 1/0)
			// Cambio el valor de los pines coilX
				for (int i = 0; i < 4; i++) {
					switch (tableSteps[i]) {
						case 0x8:
							gpio_pin_set_dt(&coil5, 0);
							gpio_pin_set_dt(&coil6, 1);
							gpio_pin_set_dt(&coil7, 1);
							gpio_pin_set_dt(&coil8, 1);
							break;
						case 0x4:
							gpio_pin_set_dt(&coil5, 1);
							gpio_pin_set_dt(&coil6, 0);
							gpio_pin_set_dt(&coil7, 1);
							gpio_pin_set_dt(&coil8, 1);
							break;
						case 0x2:
							gpio_pin_set_dt(&coil5, 1);
							gpio_pin_set_dt(&coil6, 1);
							gpio_pin_set_dt(&coil7, 0);
							gpio_pin_set_dt(&coil8, 1);
							break;
						case 0x1:
							gpio_pin_set_dt(&coil5, 1);
							gpio_pin_set_dt(&coil6, 1);
							gpio_pin_set_dt(&coil7, 1);
							gpio_pin_set_dt(&coil8, 0);
							break;
					}
					k_msleep(SLEEP_TIME);
					count_step++; //Revisar si esto está bien o es mejor ponerlo fuera del for para que cuente vueltasy no cada paso
				}


			//ret = gpio_pin_toggle_dt(&led);
			//if (ret < 0) {
			//	return;
			//}
		}

		k_msleep(5*SLEEP_TIME);
		count_step=0;

	}
	else{
		llego = 0;
		// return;							/* Esto también ni idea, lo puse porque quedaba lendo*/
	}
	printk("Llego=%d\n", llego);
}
}
```

## src/tcp_client.c
```c
// Client side C/C++ program to demonstrate Socket
// programming

#include "tcp_client.h"
#include <zephyr/kernel.h>
#include <zephyr/drivers/gpio.h>
#include <esp_log.h>

/* LOG_MODULE_DECLARE(main, CONFIG_LOG_DEFAULT_LEVEL); */

static ssize_t sendall(int sock, const void *buf, size_t len)
{
	while (len) {
		ssize_t out_len = send(sock, buf, len, 0);

		if (out_len < 0) {
			return out_len;
		}
		buf = (const char *)buf + out_len;
		len -= out_len;
	}

	return 0;
}



int tcp_client_start(void)
{
  LOG_MODULE_DECLARE(main, CONFIG_LOG_DEFAULT_LEVEL);
  /* LOG_MODULE_DECLARE(main, CONFIG_LOG_DEFAULT_LEVEL); */
  LOG_INF("tcp_client function start");

  int ret;
  int sock = 0, valread, client_fd;
  struct sockaddr_in serv_addr;
  char* hello = "Hello from esp32 client";
	char buf[RECV_BUF_SIZE];
  if ((sock = socket(AF_INET, SOCK_STREAM, 0)) < 0) {
    LOG_ERR("Socket creation error");
    return -1;
  }

  serv_addr.sin_family = AF_INET;
  serv_addr.sin_port = htons(CONFIG_PORT_SERVER);
  LOG_INF("sin_port config");

  // Convert IPv4 and IPv6 addresses from text to binary
  // form
  if (inet_pton(AF_INET, CONFIG_IP_SERVER, &serv_addr.sin_addr)
      <= 0) {
    LOG_ERR("Invalid address/ Address not supported");
    return -1;
  }

  if ((client_fd
        = connect(sock, (struct sockaddr*)&serv_addr,
          sizeof(serv_addr)))
      < 0) {
    LOG_ERR("Connection Failed %d", client_fd);
    return -1;
  }
  else
  {
    LOG_INF("Connection OK %d", client_fd);
  }

  sendall(sock, hello, strlen(hello));
  LOG_INF("Hello message sent");





  /* valread = recv(sock, buf, sizeof(buf), MSG_DONTWAIT); */
  /* LOG_INF("%s\n", buffer); */

  /* do { */
  /*   valread = recv(sock, buf, sizeof(buf), MSG_DONTWAIT); */

		/* /1* No data or error. *1/ */
		/* if (valread == 0) { */
			/* ret = -EIO; */
			/* continue; */
		/* } else if (valread < 0) { */
			/* if (errno == EAGAIN || errno == EWOULDBLOCK) { */
				/* ret = 0; */
			/* } else { */
				/* ret = -errno; */
			/* } */
			/* continue; */
		/* } */

	/* } while (valread > 0); */


  // closing the connected socket
  close(client_fd);
  return 0;
}
```
